## conf/layer.conf
```bitbake
#
# Copyright (C) 2020 Wind River Systems, Inc.
#

# We have a conf and classes directory, add to BBPATH
BBPATH =. "${LAYERDIR}:"

# We have a packages directory, add to BBFILES
BBFILES += "${LAYERDIR}/recipes-*/*/*.bb \
	${LAYERDIR}/recipes-*/*/*.bbappend"

BBFILE_COLLECTIONS += "wr-ti-j72xx"
BBFILE_PATTERN_wr-ti-j72xx := "^${LAYERDIR}/"
BBFILE_PRIORITY_wr-ti-j72xx = "7"

WRL_RECIPES:wr-ti-j72xx += " \
    devil \
"

# This should only be incremented on significant changes that will
# cause compatibility issues with other layers
LAYERVERSION_wr-ti-j72xx = "1"

LAYERDEPENDS_wr-ti-j72xx = "core wrlinux meta-ti-bsp"

LAYERSERIES_COMPAT_wr-ti-j72xx = "wrl kirkstone"

LAYERRECOMMENDS_wr-ti-j72xx = "ti-j72xx-dl"
```

## conf/machine/ti-j72xx.conf
```bitbake
#@TYPE: Machine
#@NAME: ti-j72xx
#@DESCRIPTION: Machine configuration for TI J721E SoC
DEFAULTTUNE = "cortexa72"
require conf/machine/include/tune-cortexa72.inc

MACHINE_FEATURES += "ext3 pci usbgadget usbhost vfat keyboard network"

DISTRO_FEATURES_append = " vfat serial emmc SD"

KERNEL_IMAGETYPE = ""
KERNEL_IMAGETYPES = "Image.gz Image"
KERNEL_DEVICETREE_ti-j72xx = "ti/k3-j721e-common-proc-board.dtb \
			      ti/k3-j721e-vision-apps.dtbo \
			      ti/k3-j721e-proc-board-tps65917.dtb \
			      ti/k3-j721e-pcie-backplane.dtbo \
			      ti/k3-j721e-common-proc-board-jailhouse.dtbo \
			      ti/k3-j721e-common-proc-board-infotainment.dtbo"

SERIAL_CONSOLE = "115200 ttyS0"

MACHINE_EXTRA_RRECOMMENDS = " kernel-modules kernel-devicetree"
IMAGE_FSTYPES += "tar.bz2 wic wic.bmap"
WKS_FILE ?= "j72xx-sdimage.wks"
IMAGE_INSTALL_append = " kernel-devicetree kernel-image-image"
do_image_wic[depends] += " mtools-native:do_populate_sysroot dosfstools-native:do_populate_sysroot"
IMAGE_BOOT_FILES ?= " Image k3-j721e-common-proc-board.dtb "

# multilib support
MULTILIBS ?= "multilib:lib32"
DEFAULTTUNE_virtclass-multilib-lib32 ?= "armv7athf-neon"
PREFERRED_PROVIDER_virtual/kernel ??= "linux-yocto"
PREFERRED_VERSION_linux-yocto ?= "5.4%"
MACHINE_EXTRA_RRECOMMENDS += "linux-firmware-cadence"
```
